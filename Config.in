## configs/chromax_aarch64_defconfig
```kconfig
BR2_aarch64=y
BR2_TOOLCHAIN_BUILDROOT_MUSL=y
BR2_TOOLCHAIN_BUILDROOT_CXX=y
BR2_PACKAGE_HOST_LINUX_HEADERS_CUSTOM_6_18=y
BR2_REPRODUCIBLE=y
BR2_DOWNLOAD_FORCE_CHECK_HASHES=y
BR2_GLOBAL_PATCH_DIR="$(BR2_EXTERNAL_CHROMAX_PATH)/board/chromax/patches"
BR2_TARGET_GENERIC_HOSTNAME="chromax"
BR2_TARGET_GENERIC_ISSUE="Chromax Linux 0.1 — your machine, understood"
BR2_TARGET_GENERIC_ROOT_PASSWD="!"
BR2_TARGET_GENERIC_GETTY_PORT="ttyAMA0"
BR2_SYSTEM_DHCP="eth0"
BR2_ROOTFS_OVERLAY="$(BR2_EXTERNAL_CHROMAX_PATH)/rootfs-overlay"
BR2_ROOTFS_POST_BUILD_SCRIPT="$(BR2_EXTERNAL_CHROMAX_PATH)/board/chromax/post-build.sh"
BR2_ROOTFS_POST_IMAGE_SCRIPT="$(BR2_EXTERNAL_CHROMAX_PATH)/board/chromax/post-image.sh"
BR2_ROOTFS_USERS_TABLES="$(BR2_EXTERNAL_CHROMAX_PATH)/board/chromax/users.txt"
BR2_LINUX_KERNEL=y
BR2_LINUX_KERNEL_CUSTOM_VERSION=y
BR2_LINUX_KERNEL_CUSTOM_VERSION_VALUE="6.18.60"
BR2_LINUX_KERNEL_USE_CUSTOM_CONFIG=y
BR2_LINUX_KERNEL_CUSTOM_CONFIG_FILE="board/qemu/aarch64-virt/linux.config"
BR2_LINUX_KERNEL_CONFIG_FRAGMENT_FILES="$(BR2_EXTERNAL_CHROMAX_PATH)/board/chromax/linux.fragment"
BR2_LINUX_KERNEL_NEEDS_HOST_OPENSSL=y
BR2_PACKAGE_CHROMAX=y
BR2_PACKAGE_BUSYBOX_CONFIG_FRAGMENT_FILES="$(BR2_EXTERNAL_CHROMAX_PATH)/board/chromax/busybox.fragment"
BR2_PACKAGE_LLAMA_CPP=y
BR2_PACKAGE_LLAMA_CPP_TOOLS=y
BR2_PACKAGE_CA_CERTIFICATES=y
BR2_PACKAGE_LIBCURL=y
BR2_PACKAGE_LIBCURL_CURL=y
BR2_PACKAGE_OPENSSL=y
BR2_PACKAGE_LIBOPENSSL_BIN=y
BR2_PACKAGE_DROPBEAR=y
BR2_PACKAGE_DROPBEAR_DISABLE_REVERSEDNS=y
BR2_PACKAGE_SUDO=y
BR2_PACKAGE_GIT=y
BR2_PACKAGE_GIT_CURL=y
BR2_PACKAGE_NANO=y
BR2_PACKAGE_HTOP=y
BR2_PACKAGE_IPROUTE2=y
BR2_PACKAGE_IPTABLES=y
BR2_PACKAGE_E2FSPROGS=y
BR2_PACKAGE_E2FSPROGS_RESIZE2FS=y
BR2_PACKAGE_UTIL_LINUX=y
BR2_PACKAGE_UTIL_LINUX_BINARIES=y
BR2_PACKAGE_UTIL_LINUX_AGETTY=y
BR2_PACKAGE_UTIL_LINUX_FDISK=y
BR2_PACKAGE_UTIL_LINUX_LSBLK=y
BR2_PACKAGE_UTIL_LINUX_MOUNT=y
BR2_PACKAGE_UTIL_LINUX_SU=y
BR2_TARGET_ROOTFS_EXT2=y
BR2_TARGET_ROOTFS_EXT2_4=y
BR2_TARGET_ROOTFS_EXT2_SIZE="1024M"
BR2_TARGET_ROOTFS_EXT2_LABEL="chromax-root"
BR2_TARGET_ROOTFS_TAR=y
BR2_TARGET_ROOTFS_TAR_ZSTD=y
BR2_TARGET_GRUB2=y
BR2_TARGET_GRUB2_ARM64_EFI=y
BR2_PACKAGE_HOST_GENIMAGE=y
BR2_PACKAGE_HOST_DOSFSTOOLS=y
BR2_PACKAGE_HOST_MTOOLS=y
```

## package/chromax/Config.in
```kconfig
config BR2_PACKAGE_CHROMAX
	bool "chromax"
	select BR2_PACKAGE_PYTHON3
	select BR2_PACKAGE_PYTHON3_SSL
	select BR2_PACKAGE_PYTHON3_ZLIB
	select BR2_PACKAGE_PYTHON3_READLINE
	help
	  Chromax system assistant, management tools and local web console.
```
